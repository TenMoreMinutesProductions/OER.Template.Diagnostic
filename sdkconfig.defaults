## sdkconfig.defaults
```kconfig
# FreeRTOS runtime stats (required for CPU monitoring)
CONFIG_FREERTOS_USE_TRACE_FACILITY=y
CONFIG_FREERTOS_GENERATE_RUN_TIME_STATS=y
CONFIG_FREERTOS_VTASKLIST_INCLUDE_COREID=y

# Use high-resolution timer for accurate stats
CONFIG_FREERTOS_RUN_TIME_STATS_USING_ESP_TIMER=y

# PSRAM support
CONFIG_ESP32S3_SPIRAM_SUPPORT=y
CONFIG_SPIRAM=y
CONFIG_SPIRAM_MODE_QUAD=y
CONFIG_SPIRAM_SPEED_80M=y

# Increase main task stack for diagnostics output
CONFIG_ESP_MAIN_TASK_STACK_SIZE=8192

# Console output
CONFIG_ESP_CONSOLE_UART_DEFAULT=y
CONFIG_ESP_CONSOLE_UART_BAUDRATE=115200
```
